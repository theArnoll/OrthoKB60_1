## boards/shields/arnoll_orthokb60_1/Kconfig.shield
```kconfig
config SHIELD_ARNOLL_ORTHOKB60_1
    def_bool $(shields_list_contains,arnoll_orthokb60_1)
    select SPI
    # https://github.com/petejohanson/revxlp-config/blob/main/config/boards/shields/revxlp/Kconfig.shield
```
